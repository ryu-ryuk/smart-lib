#include "ssd1306.h"
#include <string.h>
#include "driver/i2c_master.h"
#include "esp_log.h"
#include "freertos/FreeRTOS.h"
#include "freertos/semphr.h"

static const char *TAG = "SSD1306";

static i2c_master_bus_handle_t i2c_bus = NULL;
static i2c_master_dev_handle_t i2c_dev = NULL;
static SemaphoreHandle_t ssd1306_mutex = NULL;
static bool ssd1306_initialized = false;

#define SSD1306_WIDTH 128
#define SSD1306_HEIGHT 64
#define SSD1306_PAGE_COUNT (SSD1306_HEIGHT / 8)

static const uint8_t font5x7[95][5] = {
    {0x00,0x00,0x00,0x00,0x00}, {0x00,0x00,0x5F,0x00,0x00}, {0x00,0x07,0x00,0x07,0x00},
    {0x14,0x7F,0x14,0x7F,0x14}, {0x24,0x2A,0x7F,0x2A,0x12}, {0x23,0x13,0x08,0x64,0x62},
    {0x36,0x49,0x55,0x22,0x50}, {0x00,0x05,0x03,0x00,0x00}, {0x00,0x1C,0x22,0x41,0x00},
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    {0x00,0x41,0x36,0x08,0x00}, {0x10,0x08,0x08,0x10,0x08},
};

static esp_err_t ssd1306_write(uint8_t control, const uint8_t *data, size_t len) {
    if (!ssd1306_mutex || !i2c_dev) {
        return ESP_FAIL;
    }

    if (xSemaphoreTake(ssd1306_mutex, pdMS_TO_TICKS(200)) != pdTRUE) {
        return ESP_ERR_TIMEOUT;
    }

    const size_t max_payload = 1 + SSD1306_WIDTH;
    uint8_t buffer[1 + SSD1306_WIDTH] = {0};
    buffer[0] = control;

    if (data && len) {
        if (len > SSD1306_WIDTH) {
            len = SSD1306_WIDTH;
        }
        memcpy(&buffer[1], data, len);
    } else {
        len = 0;
    }

    esp_err_t err = i2c_master_transmit(i2c_dev, buffer, len + 1, pdMS_TO_TICKS(200));

    xSemaphoreGive(ssd1306_mutex);

    if (err != ESP_OK) {
        ESP_LOGW(TAG, "I2C transmit failed: %s", esp_err_to_name(err));
    }
    return err;
}

static esp_err_t ssd1306_send_command(uint8_t command) {
    return ssd1306_write(0x00, &command, 1);
}

static esp_err_t ssd1306_send_commands(const uint8_t *commands, size_t len) {
    if (!commands || len == 0) return ESP_OK;
    return ssd1306_write(0x00, commands, len);
}

static esp_err_t ssd1306_send_data(const uint8_t *data, size_t len) {
    if (!data || len == 0) return ESP_OK;
    return ssd1306_write(0x40, data, len);
}

static void ssd1306_draw_char(uint8_t line, uint8_t column, char c) {
    if (!ssd1306_initialized) return;
    if (line >= SSD1306_PAGE_COUNT) return;
    if (c < 32 || c > 126) c = ' ';

    uint8_t col = column * 6;
    if (col > SSD1306_WIDTH - 6) return;

    const uint8_t *glyph = font5x7[(uint8_t)c - 32];
    uint8_t buffer[6];
    memcpy(buffer, glyph, 5);
    buffer[5] = 0x00;

    ssd1306_send_command(0xB0 + line);
    ssd1306_send_command(0x00 | (col & 0x0F));
    ssd1306_send_command(0x10 | ((col >> 4) & 0x0F));
    ssd1306_send_data(buffer, sizeof(buffer));
}

esp_err_t ssd1306_init(const ssd1306_config_t *config) {
    if (!config) {
        return ESP_ERR_INVALID_ARG;
    }

    if (ssd1306_mutex == NULL) {
        ssd1306_mutex = xSemaphoreCreateMutex();
        if (!ssd1306_mutex) {
            return ESP_ERR_NO_MEM;
        }
    }

    if (!i2c_bus) {
        i2c_master_bus_config_t bus_config = {
            .i2c_port = config->i2c_port,
            .sda_io_num = config->sda_io,
            .scl_io_num = config->scl_io,
            .clk_source = I2C_CLK_SRC_DEFAULT,
            .flags.enable_internal_pullup = true,
        };
        esp_err_t err = i2c_new_master_bus(&bus_config, &i2c_bus);
        if (err != ESP_OK && err != ESP_ERR_INVALID_STATE) {
            ESP_LOGW(TAG, "Failed to create I2C bus: %s", esp_err_to_name(err));
            return err;
        }
    }

    if (!i2c_dev) {
        i2c_device_config_t dev_config = {
            .device_address = config->i2c_address,
            .scl_speed_hz = config->clk_speed_hz,
        };
        esp_err_t err = i2c_master_bus_add_device(i2c_bus, &dev_config, &i2c_dev);
        if (err != ESP_OK && err != ESP_ERR_INVALID_STATE) {
            ESP_LOGW(TAG, "Failed to add I2C device: %s", esp_err_to_name(err));
            return err;
        }
    }

    const uint8_t init_cmds[] = {
        0xAE, 0x20,0x00, 0xB0, 0xC8, 0x00, 0x10, 0x40,
        0x81,0x7F, 0xA1, 0xA6, 0xA8,0x3F, 0xA4, 0xD3,0x00,
        0xD5,0x80, 0xD9,0xF1, 0xDA,0x12, 0xDB,0x40,
        0x8D,0x14, 0xAF,
    };
    esp_err_t err = ssd1306_send_commands(init_cmds, sizeof(init_cmds));
    if (err != ESP_OK) {
        ESP_LOGW(TAG, "Failed to initialize OLED: %s", esp_err_to_name(err));
        return err;
    }

    ssd1306_initialized = true;
    ssd1306_clear();
    ssd1306_draw_text(0, 0, "RFID System");
    ssd1306_draw_text(2, 0, "Booting...");
    ESP_LOGI(TAG, "SSD1306 display initialized");
    return ESP_OK;
}

void ssd1306_power_off(void) {
    if (ssd1306_initialized) {
        ssd1306_send_command(0xAE);
    }
}

void ssd1306_power_on(void) {
    if (ssd1306_initialized) {
        ssd1306_send_command(0xAF);
    }
}

void ssd1306_clear(void) {
    if (!ssd1306_initialized) return;

    uint8_t zero_buffer[SSD1306_WIDTH];
    memset(zero_buffer, 0x00, sizeof(zero_buffer));

    for (uint8_t page = 0; page < SSD1306_PAGE_COUNT; page++) {
        ssd1306_send_command(0xB0 + page);
        ssd1306_send_command(0x00);
        ssd1306_send_command(0x10);
        ssd1306_send_data(zero_buffer, sizeof(zero_buffer));
    }
}

void ssd1306_draw_text(uint8_t line, uint8_t column, const char *text) {
    if (!ssd1306_initialized || !text) return;
    uint8_t col = column;
    while (*text && col < (SSD1306_WIDTH / 6)) {
        ssd1306_draw_char(line, col, *text++);
        col++;
    }
}

void ssd1306_draw_line(uint8_t page, uint8_t column, const uint8_t *data, size_t len) {
    if (!ssd1306_initialized || !data || len == 0) return;
    ssd1306_send_command(0xB0 + page);
    ssd1306_send_command(0x00 | (column & 0x0F));
    ssd1306_send_command(0x10 | ((column >> 4) & 0x0F));
    ssd1306_send_data(data, len);
}

void ssd1306_show_scanned_uid(const char *uid) {
    if (!ssd1306_initialized || !uid) return;

    ssd1306_clear();
    ssd1306_draw_text(0, 0, "CARD SCANNED");
    ssd1306_draw_text(2, 0, "UID:");
    ssd1306_draw_text(3, 0, uid);
    ssd1306_draw_text(5, 0, "Sent to gateway");
}

